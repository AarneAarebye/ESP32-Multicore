## blink/Kconfig.projbuild
```kconfig
menu "## Blink Configuration"

    config BLINK_GPIO_1
        int "Blink GPIO number 1"
        range 0 34
        default 5
        help
            GPIO number (IOxx) to blink on and off.

            Some GPIOs are used for other purposes (flash connections, etc.) and cannot be used to blink.

            GPIOs 35-39 are input-only so cannot be used as outputs.

    config BLINK_GPIO_2
        int "Blink GPIO number 2"
        range 0 34
        default 5
        help
            GPIO number (IOxx) to blink on and off.

            Some GPIOs are used for other purposes (flash connections, etc.) and cannot be used to blink.

            GPIOs 35-39 are input-only so cannot be used as outputs.
endmenu

menu "## Task Configuration"

    config BLINK_TASK_0_STACKSIZE
        int "Blink: Task 0 stack size"
        range 1000 2048
        default 1792
        help
            Stack size for task 0.

    config BLINK_TASK_1_STACKSIZE
        int "Blink: Task 1 stack size"
        range 1000 2048
        default 1792
        help
            Stack size for task 1.

endmenu
```

## template/Kconfig.projbuild
```kconfig
menu "## Task Configuration"

    config TASK_0_STACKSIZE
        int "Task 0 stack size"
        default 2048
        help
            Stack size for task 0.

    config TASK_1_STACKSIZE
        int "Task 1 stack size"
        default 2048
        help
            Stack sizef for task 1.

endmenu
```

## wlan/Kconfig.projbuild
```kconfig
menu "## Task Configuration"

    config WLAN_TASK_0_STACKSIZE
        int "WLAN: Task 0 stack size"
        default 2048
        help
            Stack size for task 0.

    config WLAN_TASK_1_STACKSIZE
        int "WLAN: Task 1 stack size"
        default 2048
        help
            Stack sizef for task 1.

endmenu

menu "## WLAN Configuration"

    config WLAN_SSID
        string "WLAN SSID (Name of the WLAN)"
        default "MY_WLAN_SSID"
        help
            Name of the WLAN network to connect to.

    config WLAN_PWD
        string "WLAN Password"
        default "MY_WLAN_PASSWORD"
        help
            Password of the WLAN network to connect to.

endmenu
```
